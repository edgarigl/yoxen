## conf/distro/yoxen.conf
```bitbake
require conf/distro/poky.conf

DISTRO = "yoxen"
DISTRO_NAME = "Yocto on Xen development distro"
DISTRO_VERSION = "2024.02.10"
DISTRO_CODENAME = "valborgs"
DISTRO_FEATURES = "acl ext2 ipv4 ipv6 xattr pci vfat multiarch sysvinit ldconfig lto virtualization xen"
QEMU_TARGETS = "i386 aarch64"

SDK_VENDOR = "-amd"
SDK_VERSION = "${@d.getVar('DISTRO_VERSION').replace('snapshot-${METADATA_REVISION}', 'snapshot')}"
SDK_VERSION[vardepvalue] = "${SDK_VERSION}"

# Remove the _sdk postfix from the default installer PATH
SDKEXTPATH = "~/${@d.getVar('DISTRO')}/${@d.getVar('SDK_VERSION')}"

MAINTAINER = " Edgar E. Iglesias <edgar.iglesias@amd.com>"

BB_SIGNATURE_HANDLER = "OEEquivHash"
BB_HASHSERVE = "auto"
BB_HASHSERVE_UPSTREAM = "hashserv.yocto.io:8687"
SSTATE_MIRRORS ?= "file://.* http://localhost:8000/sstate-cache/PATH;downloadfilename=PATH"
# Pass the variable to the SDK
ESDK_LOCALCONF_ALLOW = "SSTATE_MIRRORS"

# Drop native language support. This removes the
# eglibc->bash->gettext->libc-posix-clang-wchar dependency.
USE_NLS="no"

INHERIT += "extrausers"
# root password set to root
# echo -n 'root' | mkpasswd -5 -s | sed -e 's,\$,\\$,g'
EXTRA_USERS_PARAMS = "						\
    useradd ;						\
    usermod -p '\$1\$Jgy0ZDor\$OuYfWsK7pUIMBPUL.RHm.0' root;	\
    "
```

## conf/layer.conf
```bitbake
# We have a conf and classes directory, add to BBPATH
BBPATH =. "${LAYERDIR}:"

# We have recipes-* directories, add to BBFILES
BBFILES += "${LAYERDIR}/recipes-*/*/*.bb \
            ${LAYERDIR}/recipes-*/*/*.bbappend"

BBFILE_COLLECTIONS += "yoxen"
BBFILE_PATTERN_yoxen = "^${LAYERDIR}/"
BBFILE_PRIORITY_yoxen = "9"

LAYERSERIES_COMPAT_yoxen = "kirkstone langdale mickledore scarthgap nanbield"

# This should only be incremented on significant changes that will
# cause compatibility issues with other layers
LAYERVERSION_yoxen = "2"

LAYERDEPENDS_yoxen = "\
    core \
"
```
